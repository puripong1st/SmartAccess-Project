#ifndef THAI_FONT_H
#define THAI_FONT_H

#include <Adafruit_GFX.h>
#include <Arduino.h>

// โครงสร้างสำหรับเก็บ Glyph ภาษาไทย
struct ThaiGlyph {
  uint16_t unicode;
  uint8_t data[16]; // 8x16 pixel bitmap
};

// ตารางฟอนต์บิตแมปภาษาไทย 8x16 พิกเซล
const ThaiGlyph thai_font_table[] PROGMEM = {
  // ก-ฮ (Consonants)
  {0x0E01, {0x3E, 0x67, 0x63, 0x63, 0x60, 0x78, 0x7C, 0x66, 0x63, 0x63, 0x63, 0x63, 0x63, 0x63, 0x63, 0x00}}, // ก
  {0x0E02, {0x3C, 0x66, 0x66, 0x30, 0x18, 0x0C, 0x0C, 0x0C, 0x0C, 0x0C, 0x0C, 0x0C, 0x0E, 0x7F, 0x73, 0x00}}, // ข
  {0x0E04, {0x3A, 0x67, 0x63, 0x63, 0x60, 0x78, 0x7C, 0x66, 0x63, 0x63, 0x63, 0x63, 0x63, 0x63, 0x63, 0x00}}, // ค
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  {0x0E2E, {0x3D, 0x6E, 0x6C, 0x60, 0x60, 0x60, 0x60, 0x60, 0x60, 0x60, 0x60, 0x60, 0x66, 0x7F, 0x3B, 0x00}}, // ฮ
  
  // สระลอย (Standalone Vowels)
  {0x0E30, {0x00, 0x00, 0x00, 0x00, 0x00, 0x00, 0x00, 0x32, 0x4C, 0x4C, 0x30, 0x18, 0x26, 0x4C, 0x4C, 0x30}}, // ะ
  {0x0E32, {0x38, 0x6C, 0x0C, 0x0C, 0x0C, 0x0C, 0x0C, 0x0C, 0x0C, 0x0C, 0x0C, 0x0C, 0x0C, 0x0C, 0x0C, 0x00}}, // า
  {0x0E40, {0x0E, 0x1B, 0x1B, 0x0E, 0x0C, 0x0C, 0x0C, 0x0C, 0x0C, 0x0C, 0x0C, 0x0C, 0x0C, 0x0C, 0x0C, 0x00}}, // เ
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  {0x0E45, {0x3C, 0x6E, 0x63, 0x03, 0x03, 0x03, 0x03, 0x03, 0x03, 0x03, 0x03, 0x03, 0x03, 0x03, 0x03, 0x00}}, // ๅ

  // เครื่องหมายสระ/วรรณยุกต์บน (Combining Top Marks - Rendering offset y - 4)
  {0x0E31, {0x06, 0x0F, 0x1D, 0x18, 0x18, 0x00, 0x00, 0x00, 0x00, 0x00, 0x00, 0x00, 0x00, 0x00, 0x00, 0x00}}, //  ั
  {0x0E34, {0x3C, 0x7E, 0x42, 0x00, 0x00, 0x00, 0x00, 0x00, 0x00, 0x00, 0x00, 0x00, 0x00, 0x00, 0x00, 0x00}}, //  ิ
  {0x0E35, {0x3C, 0x7E, 0x46, 0x04, 0x04, 0x00, 0x00, 0x00, 0x00, 0x00, 0x00, 0x00, 0x00, 0x00, 0x00, 0x00}}, //  ี
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  {0x0E4C, {0x0E, 0x1B, 0x0E, 0x0C, 0x18, 0x00, 0x00, 0x00, 0x00, 0x00, 0x00, 0x00, 0x00, 0x00, 0x00, 0x00}}, //  ์ (การันต์)

  // เครื่องหมายสระล่าง (Combining Bottom Marks - Rendering offset y + 15)
  {0x0E38, {0x00, 0x00, 0x00, 0x00, 0x00, 0x00, 0x00, 0x00, 0x00, 0x00, 0x00, 0x00, 0x0C, 0x0C, 0x0E, 0x03}}, //  ุ
  {0x0E39, {0x00, 0x00, 0x00, 0x00, 0x00, 0x00, 0x00, 0x00, 0x00, 0x00, 0x00, 0x00, 0x1E, 0x12, 0x12, 0x1E}}  //  ู
};

const int THAI_FONT_SIZE = sizeof(thai_font_table) / sizeof(ThaiGlyph);

// ค้นหาบิตแมปของ Glyph ในตาราง
const uint8_t* findThaiGlyph(uint16_t unicode) {
  for (int i = 0; i < THAI_FONT_SIZE; i++) {
    if (pgm_read_word(&(thai_font_table[i].unicode)) == unicode) {
      return thai_font_table[i].data;
    }
  }
  return nullptr;
}

// เช็คประเภทของตัวอักษรภาษาไทย
bool isThaiCombiningTop(uint16_t code) {
  return (code >= 0x0E31 && code <= 0x0E37) || code == 0x0E47 || (code >= 0x0E48 && code <= 0x0E4C);
}

bool isThaiCombiningBottom(uint16_t code) {
  return (code == 0x0E38 || code == 0x0E39 || code == 0x0E3A);
}

// ฟังก์ชันถอดรหัส UTF-8
uint16_t getThaiCharCode(const char* utf8Str, int &index) {
  uint8_t b1 = utf8Str[index];
  if ((b1 & 0x80) == 0) {
    index += 1;
    return b1; // ASCII
  }
  if ((b1 & 0xE0) == 0xC0) {
    index += 2;
    return 0; // Unsupported 2-byte UTF-8
  }
  if ((b1 & 0xF0) == 0xE0) {
    uint8_t b2 = utf8Str[index+1];
    uint8_t b3 = utf8Str[index+2];
    index += 3;
    return ((b1 & 0x0F) << 12) | ((b2 & 0x3F) << 6) | (b3 & 0x3F);
  }
  index += 4;
  return 0;
}

// ฟังก์ชันหลักในการวาดข้อความภาษาไทยและอังกฤษผสมกันลงบนจอ/แคนวาส
void drawThaiText(Adafruit_GFX &gfx, const String &text, int x, int y, uint16_t color, int scale = 1) {
  int curX = x;
  int index = 0;
  int len = text.length();
  
  // เก็บตำแหน่ง X ล่าสุดของพยัญชนะฐานเพื่อวาดสระซ้อน
  int lastBaseX = x; 
  
  while (index < len) {
    int prevIndex = index;
    uint16_t code = getThaiCharCode(text.c_str(), index);
    
    if (code == 0) continue;
    
    if (code < 128) {
      // ตัวอักษร ASCII ปกติ
      gfx.drawChar(curX, y, (char)code, color, 0, scale);
      lastBaseX = curX;
      curX += 6 * scale; // ความกว้างมาตรฐานของฟอนต์ Adafruit GFX (5+1 pixel padding)
    } else {
      // ตัวอักษรภาษาไทย
      const uint8_t* glyphData = findThaiGlyph(code);
      if (glyphData) {
        if (isThaiCombiningTop(code)) {
          // สระบน หรือ วรรณยุกต์ ซ้อนด้านบนพยัญชนะฐานตัวก่อนหน้า
          // ไม้เอก/โท/ตรี/จัตวา จะวาดเยื้องขึ้นไปอีกระดับ
          int yOffset = -4;
          if (code >= 0x0E48 && code <= 0x0E4B) { // วรรณยุกต์
            yOffset = -8;
          }
          for (int gy = 0; gy < 16; gy++) {
            uint8_t row = pgm_read_byte(&(glyphData[gy]));
            for (int gx = 0; gx < 8; gx++) {
              if (row & (0x80 >> gx)) {
                gfx.fillRect(lastBaseX + gx * scale, y + (gy + yOffset) * scale, scale, scale, color);
              }
            }
          }
        } else if (isThaiCombiningBottom(code)) {
          // สระล่าง (อุ/อู) วาดด้านล่างพยัญชนะฐานตัวก่อนหน้า
          int yOffset = 13;
          for (int gy = 0; gy < 16; gy++) {
            uint8_t row = pgm_read_byte(&(glyphData[gy]));
            for (int gx = 0; gx < 8; gx++) {
              if (row & (0x80 >> gx)) {
                gfx.fillRect(lastBaseX + gx * scale, y + (gy + yOffset - 16) * scale, scale, scale, color);
              }
            }
          }
        } else {
          // พยัญชนะฐาน หรือ สระข้างปกติ (เ, แ, โ, ใ, ไ, า)
          for (int gy = 0; gy < 16; gy++) {
            uint8_t row = pgm_read_byte(&(glyphData[gy]));
            for (int gx = 0; gx < 8; gx++) {
              if (row & (0x80 >> gx)) {
                gfx.fillRect(curX + gx * scale, y + gy * scale, scale, scale, color);
              }
            }
          }
          lastBaseX = curX;
          // เลื่อนตำแหน่ง X ไปทางขวาตามขนาดฟอนต์ 8 พิกเซล
          curX += 8 * scale;
        }
      } else {
        // หากไม่พบ Glyph ให้แสดงกล่องสี่เหลี่ยมแทนตัวอักษรต่างดาว
        gfx.drawRect(curX, y, 8 * scale, 16 * scale, color);
        curX += 8 * scale;
      }
    }
  }
}

#endif // THAI_FONT_H
